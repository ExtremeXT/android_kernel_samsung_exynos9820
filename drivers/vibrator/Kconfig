## drivers/vibrator/Kconfig
```kconfig
config MOTOR_CS40L2X
	tristate "motor"
	default n
	help
	  Say Y to enable MOTOR_CS40L2X.

config MAX77705_VIBRATOR
	tristate "Maxim MAX77705 vibrator"
	default n
	depends on MFD_MAX77705
	help
	  If you say yes here you will get support for the
	  motor of Maxim MAX77705 PMIC.
	  To enable this driver, MFD_MAX77705 should be enabled and
	  MFD_MAX77705 calls this driver.

config SEC_VIBRATOR
	tristate "sec vibrator"
	default n
	help
	  If you say yes here you will get support for the
	  sec vibrator driver

config SEC_VIB_NOTIFIER
	tristate "use sec vibrator notifier"
	default n
	depends on SEC_VIBRATOR
	help
	  Enable notifier functions to get motor enable status
	  and timeout value by register notifiy
	  If you unsure, please select n
```
